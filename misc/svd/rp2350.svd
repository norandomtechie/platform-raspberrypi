# RP2350 register map
Vendor: Raspberry Pi; Series: RP; File version: 0.1
Dual Cortex-M33 or Hazard3 processors at 150MHz 520kB on-chip SRAM, in 10 independent banks Extended low-power sleep states with optional SRAM retention: as low as 10uA DVDD 8kB of one-time-programmable storage (OTP) Up to 16MB of external QSPI flash/PSRAM via dedicated QSPI bus Additional 16MB flash/PSRAM accessible via optional second chip-select On-chip switched-mode power supply to generate core voltage Low-quiescent-current LDO mode can be enabled for sleep states 2x on-chip PLLs for internal or external clock generation GPIOs are 5V-tolerant (powered), and 3.3V-failsafe (unpowered) Security features: Optional boot signing, enforced by on-chip mask ROM, with key fingerprint in OTP Protected OTP storage for optional boot decryption key Global bus filtering based on Arm or RISC-V security/privilege levels Peripherals, GPIOs and DMA channels individually assignable to security domains Hardware mitigations for fault injection attacks Hardware SHA-256 accelerator Peripherals: 2x UARTs 2x SPI controllers 2x I2C controllers 24x PWM channels USB 1.1 controller and PHY, with host and device support 12x PIO state machines 1x HSTX peripheral
CPU: CM33 r1p0, little endian, MPU, FPU, DSP, VTOR, 4 interrupt priority bits, 52 interrupts, 8 SAU regions
Registers are 32-bit, read-write, reset 0x0 unless marked. A register's access mark holds for its fields unless they carry their own. Offsets are from the block's base; lines under a group give offsets from that group; [hi:lo] are bit positions; {n}, {i} and the like mark numbered series; 'fields as' and 'values as' point back to an identical list; <NAME> marks a mode.

## Memory map
0x40000000 SYSINFO size 0x18 — Peripheral description
0x40008000 SYSCFG size 0x18 — Register block for various chip control signals
0x40010000 CLOCKS size 0xD4 — Peripheral description
0x40018000 PSM size 0x10 — Peripheral description
0x40020000 RESETS size 0xC — Peripheral description
0x40028000 IO_BANK0 size 0x320 — Peripheral description
0x40030000 IO_QSPI size 0x240 — Peripheral description
0x40038000 PADS_BANK0 size 0xCC — Peripheral description
0x40040000 PADS_QSPI size 0x1C — Peripheral description
0x40048000 XOSC size 0x14 — Controls the crystal oscillator
0x40050000 PLL_SYS size 0x20 — Peripheral description
0x40058000 PLL_USB size 0x20 — Peripheral description
0x40060000 ACCESSCTRL size 0xEC — Hardware access control registers
0x40068000 BUSCTRL size 0x2C — Register block for busfabric control signals and performance counters
0x40070000 UART0 size 0x1000 — Peripheral description
0x40078000 UART1 size 0x1000 — Peripheral description
0x40080000 SPI0 size 0x1000 — Peripheral description
0x40088000 SPI1 size 0x1000 — Peripheral description
0x40090000 I2C0 size 0x100 — DW_apb_i2c address block List of configuration constants for the Synopsys I2C hardware (you may see references to these in I2C register header; these are *fixed* values, set at hardware design time): IC_ULTRA_FAST_MODE ................ 0x0 IC_UFM_TBUF_CNT_DEFAULT ........... 0x8 IC_UFM_SCL_LOW_COUNT .............. 0x0008 IC_UFM_SCL_HIGH_COUNT ............. 0x0006 IC_TX_TL .......................... 0x0 IC_TX_CMD_BLOCK ................... 0x1 IC_HAS_DMA ........................ 0x1 IC_HAS_ASYNC_FIFO ................. 0x0 IC_SMBUS_ARP ...................... 0x0 IC_FIRST_DATA_BYTE_STATUS ......... 0x1 IC_INTR_IO ........................ 0x1 IC_MASTER_MODE .................... 0x1 IC_DEFAULT_ACK_GENERAL_CALL ....... 0x1 IC_INTR_POL ....................... 0x1 IC_OPTIONAL_SAR ................... 0x0 IC_DEFAULT_TAR_SLAVE_ADDR ......... 0x055 IC_DEFAULT_SLAVE_ADDR ............. 0x055 IC_DEFAULT_HS_SPKLEN .............. 0x1 IC_FS_SCL_HIGH_COUNT .............. 0x0006 IC_HS_SCL_LOW_COUNT ............... 0x0008 IC_DEVICE_ID_VALUE ................ 0x0 IC_10BITADDR_MASTER ............... 0x0 IC_CLK_FREQ_OPTIMIZATION .......... 0x0 IC_DEFAULT_FS_SPKLEN .............. 0x7 IC_ADD_ENCODED_PARAMS ............. 0x0 IC_DEFAULT_SDA_HOLD ............... 0x000001 IC_DEFAULT_SDA_SETUP .............. 0x64 IC_AVOID_RX_FIFO_FLUSH_ON_TX_ABRT . 0x0 IC_CLOCK_PERIOD ................... 100 IC_EMPTYFIFO_HOLD_MASTER_EN ....... 1 IC_RESTART_EN ..................... 0x1 IC_TX_CMD_BLOCK_DEFAULT ........... 0x0 IC_BUS_CLEAR_FEATURE .............. 0x0 IC_CAP_LOADING .................... 100 IC_FS_SCL_LOW_COUNT ............... 0x000d APB_DATA_WIDTH .................... 32 IC_SDA_STUCK_TIMEOUT_DEFAULT ...... 0xffffffff IC_SLV_DATA_NACK_ONLY ............. 0x1 IC_10BITADDR_SLAVE ................ 0x0 IC_CLK_TYPE ....................... 0x0 IC_SMBUS_UDID_MSB ................. 0x0 IC_SMBUS_SUSPEND_ALERT ............ 0x0 IC_HS_SCL_HIGH_COUNT .............. 0x0006 IC_SLV_RESTART_DET_EN ............. 0x1 IC_SMBUS .......................... 0x0 IC_OPTIONAL_SAR_DEFAULT ........... 0x0 IC_PERSISTANT_SLV_ADDR_DEFAULT .... 0x0 IC_USE_COUNTS ..................... 0x0 IC_RX_BUFFER_DEPTH ................ 16 IC_SCL_STUCK_TIMEOUT_DEFAULT ...... 0xffffffff IC_RX_FULL_HLD_BUS_EN ............. 0x1 IC_SLAVE_DISABLE .................. 0x1 IC_RX_TL .......................... 0x0 IC_DEVICE_ID ...................... 0x0 IC_HC_COUNT_VALUES ................ 0x0 I2C_DYNAMIC_TAR_UPDATE ............ 0 IC_SMBUS_CLK_LOW_MEXT_DEFAULT ..... 0xffffffff IC_SMBUS_CLK_LOW_SEXT_DEFAULT ..... 0xffffffff IC_HS_MASTER_CODE ................. 0x1 IC_SMBUS_RST_IDLE_CNT_DEFAULT ..... 0xffff IC_SMBUS_UDID_LSB_DEFAULT ......... 0xffffffff IC_SS_SCL_HIGH_COUNT .............. 0x0028 IC_SS_SCL_LOW_COUNT ............... 0x002f IC_MAX_SPEED_MODE ................. 0x2 IC_STAT_FOR_CLK_STRETCH ........... 0x0 IC_STOP_DET_IF_MASTER_ACTIVE ...... 0x0 IC_DEFAULT_UFM_SPKLEN ............. 0x1 IC_TX_BUFFER_DEPTH ................ 16
0x40098000 I2C1 size 0x100 — Peripheral description
0x400A0000 ADC size 0x24 — Control and data interface to SAR ADC
0x400A8000 PWM size 0x110 — Simple PWM
0x400B0000 TIMER0 size 0x4C — Controls time and alarms time is a 64 bit value indicating the time since power-on timeh is the top 32 bits of time & timel is the bottom 32 bits to change time write to timelw before timehw to read time read from timelr before timehr An alarm is set by setting alarm_enable and writing to the corresponding alarm register When an alarm is pending, the corresponding alarm_running signal will be high An alarm can be cancelled before it has finished by clearing the alarm_enable When an alarm fires, the corresponding alarm_irq is set and alarm_running is cleared To clear the interrupt write a 1 to the corresponding alarm_irq The timer can be locked to prevent writing
0x400B8000 TIMER1 size 0x4C — Peripheral description
0x400C0000 HSTX_CTRL size 0x2C — Control interface to HSTX. For FIFO write access and status, see the HSTX_FIFO register block.
0x400C8000 XIP_CTRL size 0x20 — QSPI flash execute-in-place block
0x400D0000 QMI size 0x54 — QSPI Memory Interface. Provides a memory-mapped interface to up to two SPI/DSPI/QSPI flash or PSRAM devices. Also provides a serial interface for programming and configuration of the external device.
0x400D8000 WATCHDOG size 0x2C — Peripheral description
0x400E0000 BOOTRAM size 0x82C — Additional registers mapped adjacent to the bootram, for use by the bootrom.
0x400E8000 ROSC size 0x28 — Peripheral description
0x400F0000 TRNG size 0x1EC — ARM TrustZone RNG register block
0x400F8000 SHA256 size 0x28 — SHA-256 hash function implementation
0x40100000 POWMAN size 0xF0 — Controls vreg, bor, lposc, chip resets & xosc startup, powman and provides scratch register for general use and for bootcode use
0x40108000 TICKS size 0x48 — Peripheral description
0x40120000 OTP size 0x174 — SNPS OTP control IF (SBPI and RPi wrapper control)
0x40130000 OTP_DATA size 0x1EF0 — Predefined OTP data layout for RP2350
0x40134000 OTP_DATA_RAW size 0x4000 — Predefined OTP data layout for RP2350
0x40158000 GLITCH_DETECTOR size 0x18 — Glitch detector controls
0x40160000 TBMAN size 0x4 — For managing simulation testbenches
0x50000000 DMA size 0xBC8 — DMA with separate read and write masters
0x50100000 USB_DPRAM size 0x100 — DPRAM layout for USB device.
0x50110000 USB size 0x118 — USB FS/LS controller device registers
0x50200000 PIO0 size 0x188 — Programmable IO block
0x50300000 PIO1 size 0x188 — Peripheral description
0x50400000 PIO2 size 0x188 — Peripheral description
0x50500000 XIP_AUX size 0xC — Auxiliary DMA access to XIP FIFOs, via fast AHB bus access
0x50600000 HSTX_FIFO size 0x8 — FIFO status and write access for HSTX
0x50700000 CORESIGHT_TRACE size 0x8 — Coresight block - RP specific registers
0xD0000000 SIO size 0x1E8 — Single-cycle IO block Provides core-local and inter-core hardware for the two processors, with single-cycle access.
0xD0020000 SIO_NS size 0x1E8 — Peripheral description
0xE0000000 PPB size 0x43000 — TEAL registers accessible through the debug interface
0xE0020000 PPB_NS size 0x43000 — Peripheral description
0xE0080000 EPPB size 0xC — Cortex-M33 EPPB vendor register block for RP2350

## Interrupts
0 TIMER0_IRQ_0 (TIMER0)
1 TIMER0_IRQ_1 (TIMER0)
2 TIMER0_IRQ_2 (TIMER0)
3 TIMER0_IRQ_3 (TIMER0)
4 TIMER1_IRQ_0 (TIMER1)
5 TIMER1_IRQ_1 (TIMER1)
6 TIMER1_IRQ_2 (TIMER1)
7 TIMER1_IRQ_3 (TIMER1)
8 PWM_IRQ_WRAP_0 (PWM)
9 PWM_IRQ_WRAP_1 (PWM)
10 DMA_IRQ_0 (DMA)
11 DMA_IRQ_1 (DMA)
12 DMA_IRQ_2 (DMA)
13 DMA_IRQ_3 (DMA)
14 USBCTRL_IRQ (USB)
15 PIO0_IRQ_0 (PIO0)
16 PIO0_IRQ_1 (PIO0)
17 PIO1_IRQ_0 (PIO1)
18 PIO1_IRQ_1 (PIO1)
19 PIO2_IRQ_0 (PIO2)
20 PIO2_IRQ_1 (PIO2)
21 IO_IRQ_BANK0 (IO_BANK0)
22 IO_IRQ_BANK0_NS (IO_BANK0)
23 IO_IRQ_QSPI (IO_QSPI)
24 IO_IRQ_QSPI_NS (IO_QSPI)
25 SIO_IRQ_FIFO (SIO)
26 SIO_IRQ_BELL (SIO)
27 SIO_IRQ_FIFO_NS (SIO)
28 SIO_IRQ_BELL_NS (SIO)
29 SIO_IRQ_MTIMECMP (SIO)
30 CLOCKS_IRQ (CLOCKS)
31 SPI0_IRQ (SPI0)
32 SPI1_IRQ (SPI1)
33 UART0_IRQ (UART0)
34 UART1_IRQ (UART1)
35 ADC_IRQ_FIFO (ADC)
36 I2C0_IRQ (I2C0)
37 I2C1_IRQ (I2C1)
38 OTP_IRQ (OTP)
39 TRNG_IRQ (TRNG)
42 PLL_SYS_IRQ (PLL_SYS)
43 PLL_USB_IRQ (PLL_USB)
44 POWMAN_IRQ_POW (POWMAN)
45 POWMAN_IRQ_TIMER (POWMAN)

## Licence text in the file
Copyright (c) 2024 Raspberry Pi Ltd. SPDX-License-Identifier: BSD-3-Clause
